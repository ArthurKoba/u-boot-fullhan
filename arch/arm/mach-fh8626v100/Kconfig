## arch/arm/mach-fh8626v100/Kconfig
```kconfig
if ARCH_FH8626V100

config SYS_ARCH
	default "arm"

config SYS_SOC
	default "fh8626v100"

config TEXT_BASE
	default 0xa3000000

config CUSTOM_SYS_INIT_SP_ADDR
	default 0xa2f00000

config TARGET_FH8626V100
	bool "ANJIA AJL33PQ0866 (Fullhan FH8626V100)"
	default y
	help
	  Enable U-Boot for the ANJIA AJL33PQ0866 camera built around the
	  Fullhan FH8626V100. SoC support is reusable, but the validated DDR
	  bootstrap data, RMII wiring and flash migration contract are specific
	  to this board until another FH8626V100 board is independently verified.

source "board/fullhan/fh8626v100/Kconfig"

endif
```

## board/fullhan/fh8626v100/Kconfig
```kconfig
if TARGET_FH8626V100

config SYS_BOARD
	default "fh8626v100"

config SYS_VENDOR
	default "fullhan"

config SYS_CONFIG_NAME
	default "fh8626v100"

config FH8626V100_STOCK_COMPAT
	bool "Enable Fullhan stock U-Boot compatibility helpers"
	help
	  Enable compatibility commands used only while migrating an
	  AJL33PQ0866 from its factory Fullhan environment. Production OpenIPC
	  images should leave this disabled and use native OpenIPC environment
	  variables and command syntax.

endif
```

## configs/fh8626v100_flash_defconfig
```kconfig
CONFIG_ARM=y
CONFIG_SYS_DCACHE_OFF=y
CONFIG_ARCH_FH8626V100=y
CONFIG_SUPPORT_PASSING_ATAGS=y
CONFIG_CMDLINE_TAG=y
CONFIG_INITRD_TAG=y
CONFIG_STATIC_MACH_TYPE=y
CONFIG_MACH_TYPE=9999
CONFIG_TEXT_BASE=0xA0800000
CONFIG_SYS_MALLOC_LEN=0x80000
CONFIG_CUSTOM_SYS_INIT_SP_ADDR=0xA3F00000
CONFIG_NR_DRAM_BANKS=1
CONFIG_ENV_SIZE=0x10000
CONFIG_ENV_OFFSET=0x10000
CONFIG_ENV_SECT_SIZE=0x10000
CONFIG_DM_GPIO=y
CONFIG_DEFAULT_DEVICE_TREE="fh8626v100"
CONFIG_SYS_LOAD_ADDR=0xA1000000
CONFIG_DEBUG_UART_BASE=0xF0700000
CONFIG_DEBUG_UART_CLOCK=16666667
CONFIG_IDENT_STRING="-fh8626v100"
CONFIG_DEBUG_UART=y
CONFIG_LTO=y
CONFIG_BOOTDELAY=1
CONFIG_USE_BOOTCOMMAND=y
CONFIG_BOOTCOMMAND="run openipc_boot"
# CONFIG_DISPLAY_CPUINFO is not set
CONFIG_SYS_PROMPT="FH8626V100 # "
# CONFIG_CMD_BDI is not set
# CONFIG_CMD_CONSOLE is not set
# CONFIG_CMD_BOOTD is not set
# CONFIG_BOOTM_PLAN9 is not set
# CONFIG_BOOTM_RTEMS is not set
# CONFIG_BOOTM_VXWORKS is not set
# CONFIG_CMD_ELF is not set
# CONFIG_CMD_FDT is not set
# CONFIG_CMD_XIMG is not set
# CONFIG_CMD_EXPORTENV is not set
# CONFIG_CMD_IMPORTENV is not set
# CONFIG_CMD_ENV_EXISTS is not set
# CONFIG_CMD_RANDOM is not set
# CONFIG_CMD_DM is not set
CONFIG_CMD_GPIO=y
# CONFIG_CMD_LOADB is not set
# CONFIG_CMD_LOADS is not set
# CONFIG_CMD_ITEST is not set
# CONFIG_CMD_SOURCE is not set
# CONFIG_CMD_SETEXPR is not set
# CONFIG_CMD_BOOTP is not set
CONFIG_CMD_TFTPPUT=y
CONFIG_CMD_MII=y
# CONFIG_CMD_MDIO is not set
CONFIG_CMD_PING=y
# CONFIG_CMD_SLEEP is not set
CONFIG_MTDPARTS_DEFAULT="spi_flash:64k(bootstrap)ro,64k(uboot-env),192k(uboot)ro,3M(kernel),1M(rootfs_data),-(rootfs)"
CONFIG_ENV_IS_IN_SPI_FLASH=y
CONFIG_ENV_SPI_MAX_HZ=50000000
CONFIG_ENV_SPI_MODE=0
CONFIG_NET_RANDOM_ETHADDR=y
CONFIG_DWAPB_GPIO=y
# CONFIG_MMC is not set
CONFIG_MTD=y
CONFIG_DM_SPI_FLASH=y
# CONFIG_SPI_FLASH_LOCK is not set
# CONFIG_SPI_FLASH_UNLOCK_ALL is not set
CONFIG_SPI_FLASH_MACRONIX=y
CONFIG_ETH_DESIGNWARE_FH8626V100=y
CONFIG_DM_SERIAL=y
CONFIG_DEBUG_UART_SHIFT=2
CONFIG_SYS_NS16550=y
CONFIG_SYS_NS16550_MEM32=y
CONFIG_SPI=y
CONFIG_DM_SPI=y
CONFIG_DESIGNWARE_SPI=y
CONFIG_DESIGNWARE_APB_TIMER=y
# CONFIG_REGEX is not set
```

## configs/fh8626v100_ram_defconfig
```kconfig
CONFIG_ARM=y
CONFIG_SYS_DCACHE_OFF=y
CONFIG_ARCH_FH8626V100=y
CONFIG_SUPPORT_PASSING_ATAGS=y
CONFIG_CMDLINE_TAG=y
CONFIG_INITRD_TAG=y
CONFIG_STATIC_MACH_TYPE=y
CONFIG_MACH_TYPE=9999
CONFIG_TEXT_BASE=0xA3000000
CONFIG_SYS_MALLOC_LEN=0x200000
CONFIG_CUSTOM_SYS_INIT_SP_ADDR=0xA2F00000
CONFIG_NR_DRAM_BANKS=1
CONFIG_ENV_SIZE=0x10000
CONFIG_DM_GPIO=y
CONFIG_DEFAULT_DEVICE_TREE="fh8626v100"
CONFIG_SYS_LOAD_ADDR=0xA1000000
CONFIG_DEBUG_UART_BASE=0xF0700000
CONFIG_DEBUG_UART_CLOCK=16666667
CONFIG_IDENT_STRING="-fh8626v100-ram"
CONFIG_DEBUG_UART=y
CONFIG_BOOTDELAY=-1
CONFIG_USE_BOOTCOMMAND=y
CONFIG_BOOTCOMMAND="run openipc_boot"
# CONFIG_DISPLAY_CPUINFO is not set
CONFIG_SYS_PROMPT="FH8626V100 # "
CONFIG_CMD_GPIO=y
CONFIG_CMD_TFTPPUT=y
CONFIG_CMD_MII=y
CONFIG_CMD_PING=y
CONFIG_MTDPARTS_DEFAULT="spi_flash:64k(bootstrap)ro,64k(uboot-env),192k(uboot)ro,3M(kernel),1M(rootfs_data),-(rootfs)"
CONFIG_NET_RANDOM_ETHADDR=y
CONFIG_DWAPB_GPIO=y
CONFIG_MTD=y
CONFIG_DM_SPI_FLASH=y
CONFIG_SPI_FLASH_MACRONIX=y
CONFIG_ETH_DESIGNWARE_FH8626V100=y
CONFIG_DM_SERIAL=y
CONFIG_DEBUG_UART_SHIFT=2
CONFIG_SYS_NS16550=y
CONFIG_SYS_NS16550_MEM32=y
CONFIG_SPI=y
CONFIG_DM_SPI=y
CONFIG_DESIGNWARE_SPI=y
CONFIG_DESIGNWARE_APB_TIMER=y
```
